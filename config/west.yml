## config/west.yml
```yaml
manifest:
    remotes:
        - name: zmkfirmware
          url-base: https://github.com/zmkfirmware
        - name: lucien_duchateau
          url-base: https://github.com/Lucien-Duchateau
        # Additional modules containing boards/shields/custom code can be listed here as well
        # See https://docs.zephyrproject.org/3.2.0/develop/west/manifest.html#projects
    projects:
        - name: zmk
          remote: zmkfirmware
          revision: main
          import: app/west.yml
        - name: MFMacro
          remote: lucien_duchateau
    self:
        path: config
```
